# Musca_S1 register map
Vendor: ARM Ltd.; Series: ARMv8-M Mainline; File version: 1.0
CPU: CM33 r0p1, little endian, MPU, no FPU, 3 interrupt priority bits, 8 SAU regions
Registers are 32-bit, read-write, reset 0x0 unless marked. A register's access mark holds for its fields unless they carry their own. Offsets are from the block's base; [hi:lo] are bit positions; {n}, {i} and the like mark numbered series.

## I2S0
Base 0x40106000
Same registers: I2S0_Secure 0x50106000
0x00 CTRL reset 0x1900000 — Transceiver Control Register
0x04 INTR_STAT reset 0x3300 — Interrupt Status Register
0x08 SRR — Sample Rate and Resolution Control Register
0x0C CID_CTRL — Clock Strobes and Interrupt Masks Control Register
0x10 TFIFO_STAT — Transmit FIFO Level Status Register
0x14 RFIFO_STAT — Receive FIFO Level Status Register
0x18 TFIFO_CTRL reset 0xF0000 — Transmit FIFO Thresholds Control Register
0x1C RFIFO_CTRL reset 0xF0000 — Receive FIFO Rhresholds Control Register
0x20 DEV_CONF reset 0x208 — Device Configuration Register
0x24 POLL_STAT reset 0x3 — Polling Status Register

## SYSCTRL — System Control (Secure)
Base 0x50021000
0x00 SECDBGSTAT ro — Secure Debug Configuration Status Register
0x04 SECDBGSET wo — Secure Debug Configuration Set Register
0x08 SECDBGCLR wo — Secure Debug Configuration Clear Register
0x0C SCSECCTRL — System Control Security Control Register
0x10 FCLK_DIV — Fast Clock Divider Configuration Register
0x14 SYSCLK_DIV — System Clock Divider Configuration Register
0x18 CLOCK_FORCE — Clock Forces
0x100 RESET_SYNDROME reset 0x1
0x104 RESET_MASK reset 0x30
0x108 SWRESET wo — Software Reset
0x10C GRETREG — General Purpose Retention Register
0x110 INITSVTOR0 — Initial Secure Reset Vector Register For CPU 0
0x114 INITSVTOR1 — Initial Secure Reset Vector Register For CPU 1
0x118 CPUWAIT — CPU Boot wait control after reset
0x11C NMI_ENABLE reset 0x1
0x120 WICCTRL — CPU WIC Request and Acknowledgement
0x124 EWCTRL — External Wakeup Control
0x200 PDCM_PD_SYS_SENSE reset 0x7F — Power Control Dependency Matrix PD_SYS Power Domain Sensitivity
{0x20C+4i} PDCM_PD_SRAM{i}_SENSE (i=0..3) — Power Control Dependency Matrix PD_SRAM{i} Power Domain Sensitivity

## SPCTRL — Secure Privilege Control Block
Base 0x50080000
0x00 SPCSECTRL — Secure Privilege Controller Secure Configuration Control Register
0x04 BUSWAIT — Bus Access wait control after reset
0x10 SECRESPCFG — Security Violation Response Configuration Register
0x14 NSCCFG — Non Secure Callable Configuration for IDAU
0x1C SECMPCINTSTATUS ro — Secure MPC Interrupt Status
0x20 SECPPCINTSTAT ro — Secure PPC Interrupt Status
0x24 SECPPCINTCLR wo — Secure PPC Interrupt Clear
0x28 SECPPCINTEN — Secure PPC Interrupt Enable
0x30 SECMSCINTSTAT ro — Secure MSC Interrupt Status
0x34 SECMSCINTCLR — Secure MSC Interrupt Clear
0x38 SECMSCINTEN — Secure MSC Interrupt Enable
0x40 BRGINTSTAT ro — Bridge Buffer Error Interrupt Status
0x44 BRGINTCLR wo — Bridge Buffer Error Interrupt Clear
0x48 BRGINTEN — Bridge Buffer Error Interrupt Enable
0x50 AHBNSPPC0 — Non-Secure Access AHB slave Peripheral Protection Control 0
{0x60+4i} AHBNSPPCEXP{i} (i=0..3) — Expansion {i} Non_Secure Access AHB slave Peripheral Protection Control
0x70 APBNSPPC0 — Non-Secure Access APB slave Peripheral Protection Control 0
0x74 APBNSPPC1 — Non-Secure Access APB slave Peripheral Protection Control 1
{0x80+4i} APBNSPPCEXP{i} (i=0..3) — Expansion {i} Non_Secure Access APB slave Peripheral Protection Control
0x90 AHBSPPPC0 ro — Secure Unprivileged Access AHB slave Peripheral Protection Control 0
{0xA0+4i} AHBSPPPCEXP{i} (i=0..3) — Expansion {i} Secure Unprivileged Access AHB slave Peripheral Protection Control
0xB0 APBSPPPC0 — Secure Unprivileged Access APB slave Peripheral Protection Control 0
0xB4 APBSPPPC1 — Secure Unprivileged Access APB slave Peripheral Protection Control 1
{0xC0+4i} APBSPPPCEXP{i} (i=0..3) — Expansion {i} Secure Unprivileged Access APB slave Peripheral Protection Control
0xD0 NSMSCEXP ro — Expansion MSC Non-Secure Configuration
